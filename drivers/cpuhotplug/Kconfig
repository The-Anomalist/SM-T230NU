## drivers/cpuhotplug/Kconfig
```kconfig
choice
        prompt "Support dynamic CPU Hotplug"
        depends on HOTPLUG_CPU
        default NO_HOTPLUG_POLICY

config CPU_HOTPLUG_POL_STANDALONE
        bool "Stand alone CPU hotplug policy"
        help
          PM hotplug policy.
          Enable to use pm hotplug, then it uses stand-hotplug.c file.
          Avg-load is calculated with both cpu frequency aspect
          and run queue status.

config CPU_HOTPLUG_INTELLIPLUG
        bool "Intelliplug 4.0 (experimental, PXA1088 port)"
        help
          Faux123 Intelliplug candidate for experimental compatibility testing.
          Select ONLY after scheduler symbols and suspend compatibility are verified.

config NO_HOTPLUG_POLICY
        bool "NO automatic CPU hotplug policy"
        help
          PM hotplug policy
          Do not select an automatic hotplug policy
endchoice
```
